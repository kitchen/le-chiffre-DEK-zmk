## boards/shields/le_chiffre_democratique/Kconfig.defconfig
```kconfig
if SHIELD_LE_CHIFFRE_DEMOCRATIQUE

  config ZMK_KEYBOARD_NAME
    default "DEK le Chiffre"

  config SPI
    default y

endif
```

## boards/shields/le_chiffre_democratique/Kconfig.shield
```kconfig
config SHIELD_LE_CHIFFRE_DEMOCRATIQUE
  def_bool $(shields_list_contains,le_chiffre_democratique)
```
