
/ {
  encoder: encoder {
    compatible = "alps,ec11";
    steps = <80>;
    status = "disabled";
    a-gpios = <&pro_micro 1 (GPIO_ACTIVE_HIGH | GPIO_PULL_UP)>;
    b-gpios = <&pro_micro 2 (GPIO_ACTIVE_HIGH | GPIO_PULL_UP)>;
  };

  sensors: sensors {
    compatible = "zmk,keymap-sensors";
    sensors = <&encoder>;
    triggers-per-rotation = <20>;
  };
};
