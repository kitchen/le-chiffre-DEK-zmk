#include <behaviors.dtsi>
#include <dt-bindings/zmk/keys.h>

/ {
  keymap {
    compatible = "zmk,keymap";

    default_layer {
      bindings = <
        &kp Z
        &kp Z
        &kp Z
        &kp Z
        &kp Z
        &kp Z
        &kp Z
        &kp Z
        &kp Z
        &kp Z
        &kp Z
        &kp Z
        &kp Z
        &kp Z
        &kp Z
        &kp Z
        &kp Z
        &kp Z
        &kp Z
        &kp Z
        &kp Z
        &kp Z
        &kp Z
        &kp Z
        &kp Z
        &kp Z
        &kp Z
        &kp Z
        &kp Z
        &kp Z
        &kp Z
        &kp Z
        &kp Z
        &kp Z
        &kp Z
        &kp Z
        &kp Z
      >;

      sensor-bindings = <&inc_dec_kp Z Z>;
    };
  };
};
